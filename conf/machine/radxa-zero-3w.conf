## conf/machine/radxa-zero-3w.conf
```bitbake
# Copyright (c) 2024 Bartosz Szostak
# This software is released under the MIT License.
# See the LICENSE file for more details.

require conf/machine/include/radxa-zero-3.inc

KERNEL_DEVICETREE = "rockchip/rk3566-radxa-zero-3w.dtb"
```
